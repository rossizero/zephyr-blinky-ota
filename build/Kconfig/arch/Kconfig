## build/Kconfig/arch/Kconfig
```kconfig
# Load Zephyr Arch Kconfig descriptions.
osource "C:/Users/SebastianR/Desktop/repos/zephyr-blinky-ota/zephyr-project/zephyr/arch/rx/Kconfig"
osource "C:/Users/SebastianR/Desktop/repos/zephyr-blinky-ota/zephyr-project/zephyr/arch/x86/Kconfig"
osource "C:/Users/SebastianR/Desktop/repos/zephyr-blinky-ota/zephyr-project/zephyr/arch/xtensa/Kconfig"
osource "C:/Users/SebastianR/Desktop/repos/zephyr-blinky-ota/zephyr-project/zephyr/arch/sparc/Kconfig"
osource "C:/Users/SebastianR/Desktop/repos/zephyr-blinky-ota/zephyr-project/zephyr/arch/riscv/Kconfig"
osource "C:/Users/SebastianR/Desktop/repos/zephyr-blinky-ota/zephyr-project/zephyr/arch/posix/Kconfig"
osource "C:/Users/SebastianR/Desktop/repos/zephyr-blinky-ota/zephyr-project/zephyr/arch/mips/Kconfig"
osource "C:/Users/SebastianR/Desktop/repos/zephyr-blinky-ota/zephyr-project/zephyr/arch/arm64/Kconfig"
osource "C:/Users/SebastianR/Desktop/repos/zephyr-blinky-ota/zephyr-project/zephyr/arch/arm/Kconfig"
osource "C:/Users/SebastianR/Desktop/repos/zephyr-blinky-ota/zephyr-project/zephyr/arch/arc/Kconfig"
```

## build/Kconfig/boards/Kconfig
```kconfig
# Load Zephyr board Kconfig descriptions.
osource "C:/Users/SebastianR/Desktop/repos/zephyr-blinky-ota/zephyr-project/zephyr/boards/espressif/esp32_devkitc/Kconfig"
```

## build/Kconfig/boards/Kconfig.defconfig
```kconfig
# Load Zephyr board defconfig descriptions.
osource "C:/Users/SebastianR/Desktop/repos/zephyr-blinky-ota/zephyr-project/zephyr/boards/espressif/esp32_devkitc/Kconfig.defconfig"
```

## build/Kconfig/boards/Kconfig.esp32_devkitc
```kconfig
# Load board Kconfig descriptions.
osource "C:/Users/SebastianR/Desktop/repos/zephyr-blinky-ota/zephyr-project/zephyr/boards/espressif/esp32_devkitc/Kconfig.esp32_devkitc"
```

## zephyr-project/app/sysbuild/mcuboot/boards/esp32c3_devkitc.conf
```kconfig
CONFIG_BOOT_SIGNATURE_TYPE_ED25519=y
CONFIG_BOOT_SIGNATURE_KEY_FILE="C:/Users/SebastianR/Desktop/repos/zephyr-blinky-ota/zephyr-project/keys/ed25519.pem"

#ki solution (not tested) to enable atomic operation support for riscv
# to prevent the following error:
# relocation truncated to fit: R_RISCV_RVC_JUMP against symbol `esp_log_timestamp' defined in .text.esp_log_early_timestamp section in zephyr/libzephyr.a(log_noos.c.obj)

#CONFIG_SIZE_OPTIMIZATIONS=y
#CONFIG_MINIMAL_LIBC=y
#CONFIG_MAIN_STACK_SIZE=2048


#CONFIG_LOG=n
#CONFIG_PRINTK=n
#CONFIG_ASSERT=n
#CONFIG_SYSTEM_WORKQUEUE_STACK_SIZE=1024
```

## zephyr-project/app/sysbuild/mcuboot/boards/esp32s3_devkitc_procpu.conf
```kconfig
# necessary for flash access (e.g. reading the image headers)
CONFIG_ESPTOOLPY_FLASHMODE_QIO=y
CONFIG_ESPTOOLPY_FLASHFREQ_80M=y
```
